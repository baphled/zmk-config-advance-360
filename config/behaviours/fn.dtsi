/ {
    behaviors {
        /omit-if-no-ref/ media_keys: behavior_media_keys {
            compatible = "zmk,behavior-caps-word";
            label = "MEDIA_KEYS";
            #binding-cells = <0>;
            mods = <MOD_LSFT>;
            continue-list = <UNDERSCORE BACKSPACE DELETE>;
            ignore-alphas;
            ignore-numbers;
            ignore-modifiers;
        };
    };
};

// tap smart-fn | double-tap: sticky fn-layer | hold: fn-layer
#define SMART_FN &smart_fn FN 1
ZMK_BEHAVIOR(smart_fn, hold_tap,
    flavor = "balanced";
    tapping-term-ms = <200>;
    quick-tap-ms = <QUICK_TAP_MS>;
    bindings = <&mo>, <&fn_dance>;
)

ZMK_BEHAVIOR(fn_dance, tap_dance,
    tapping-term-ms = <200>;
    bindings = <&media_keys>, <&sl FN>;
)

/*
 * typically, we want to use the FN layer for modifiers, but we also want to
 * use the FN layer for the FN keys. This behaviour allows us to use the FN
 * layer for modifiers, but not for the FN keys.
 *
 */
&media_keys {  // num-word, requires PR #1451
  layers = <FN>;
  continue-list = <C_PREV C_NEXT C_VOL_UP C_VOL_UP C_VOL_DN RSHFT LALT>;
};
